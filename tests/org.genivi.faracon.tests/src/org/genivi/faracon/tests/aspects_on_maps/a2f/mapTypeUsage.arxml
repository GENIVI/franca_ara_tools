AUTOSAR XML (schema 4.0)
package /a1/b2/c3
  service interface TestInterface
    methods:
      operation testMethod
        arg simpleMapIn: type=simpleMap, direction=IN
        arg structMapIn: type=structMap, direction=IN
  impl type simpleMap: category=ASSOCIATIVE_MAP
    element myKeyType: implementation-data-type=UInt16
    element myValueType: implementation-data-type=UInt32
  impl type structMap: category=ASSOCIATIVE_MAP
    element myStructKeyType: implementation-data-type=TestStruct
    element myUint32ValueType: implementation-data-type=UInt32
  impl type TestStruct: category=STRUCTURE
    element testMember: implementation-data-type=Int32
