AUTOSAR XML (schema 4.0)
package /x/y/z/commonTypes
  impl type CommonArrayElementEnumerationType: category=TYPE_REFERENCE, compu {=E1, =E2, =E3, =E4}
  impl type CommonArrayElementStructType: category=STRUCTURE
    element field_a: implementation-data-type=String
    element field_b: implementation-data-type=Boolean
