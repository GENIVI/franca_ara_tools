AUTOSAR XML (schema 4.0)
package /a1/b2/c3
  service interface ExampleInterface
    namespaces:
      symbol props a1
      symbol props b2
      symbol props c3
    methods:
      operation methodWithUserDefinedTypeArguments
        arg struct_argument: type=UserDefinedStructType, direction=IN
        arg named_array_argument: type=SimpleNamedArrayType, direction=IN
package /a1/b2/c3/ExampleInterface
  impl type SimpleNamedArrayType: category=VECTOR
    element valueType: array-size-semantics=VARIABLE-SIZE, implementation-data-type=UInt32
  impl type UserDefinedStructType: category=STRUCTURE
    element field_1: implementation-data-type=SimpleNamedArrayType
    element field_2: implementation-data-type=Boolean
    element field_3: implementation-data-type=SimpleNamedArrayType
