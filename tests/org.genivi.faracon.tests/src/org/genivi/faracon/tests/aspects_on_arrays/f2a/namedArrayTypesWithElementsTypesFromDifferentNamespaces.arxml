AUTOSAR XML (schema 4.0)
package /a1/b2/c3
  service interface ExampleInterface
    namespaces:
      symbol props a1
      symbol props b2
      symbol props c3
    methods:
      operation methodWithUserDefinedTypeArguments
        arg anonymous_array_argument: type=ComplexNamedArrayType, direction=IN
        arg anonymous_array_argument_2: type=ComplexNamedArrayType2, direction=IN
        arg anonymous_array_argument_3: type=ComplexNamedArrayType3, direction=IN
package /a1/b2/c3/ExampleInterface
  impl type ComplexNamedArrayType: category=VECTOR
    element valueType: array-size-semantics=VARIABLE-SIZE, implementation-data-type=CommonArrayElementStructType
  impl type ComplexNamedArrayType2: category=VECTOR
    element valueType: array-size-semantics=VARIABLE-SIZE, implementation-data-type=CommonArrayElementStructType
  impl type ComplexNamedArrayType3: category=VECTOR
    element valueType: array-size-semantics=VARIABLE-SIZE, implementation-data-type=CommonArrayElementStructType
