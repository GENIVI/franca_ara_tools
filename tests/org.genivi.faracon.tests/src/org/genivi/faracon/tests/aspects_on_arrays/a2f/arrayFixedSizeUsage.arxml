AUTOSAR XML (schema 4.0)
package /a1/b2/c3
  service interface TestInterface
    methods:
      operation testMethod
        arg simpleArrayIn: type=simpleArray, direction=IN
        arg structArrayIn: type=structArray, direction=IN
  impl type simpleArray: category=VECTOR
    sub elements valueType: implementation-data-type-element={category=TYPE_REFERENCE, array-size-semantics=FIXED-SIZE, array-size=21, implementation-data-type=UInt16}
  impl type structArray: category=VECTOR
    element valueType: array-size-semantics=FIXED-SIZE, array-size=42, implementation-data-type=TestStruct
  impl type TestStruct: category=STRUCTURE
    element testMember: implementation-data-type=Int32
