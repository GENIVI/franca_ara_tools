AUTOSAR XML (schema 4.0)
package /a1/b2/c3
  impl type simpleArray: category=VECTOR
    sub elements valueType: implementation-data-type-element={category=TYPE_REFERENCE, implementation-data-type=UInt16}
  impl type structArray: category=VECTOR
    element valueType: implementation-data-type=TestStruct
  impl type TestStruct: category=STRUCTURE
    element testMember: implementation-data-type=Int32
