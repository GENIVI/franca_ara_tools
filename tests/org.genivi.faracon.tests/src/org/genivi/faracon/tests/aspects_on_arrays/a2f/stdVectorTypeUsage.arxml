AUTOSAR XML (schema 4.0)
package /a1/b2/c3
  service interface TestInterface
    methods:
      operation testMethod
        arg simpleArrayIn: type=UInt32Vector, direction=IN
