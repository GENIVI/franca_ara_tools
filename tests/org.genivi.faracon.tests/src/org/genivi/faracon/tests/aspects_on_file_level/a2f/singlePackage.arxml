AUTOSAR XML (schema 4.0)
package /empty_namespace
  service interface InterfaceWithNamespace
