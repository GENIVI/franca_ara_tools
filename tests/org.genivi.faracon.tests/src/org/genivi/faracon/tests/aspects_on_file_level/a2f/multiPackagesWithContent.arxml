AUTOSAR XML (schema 4.0)
package /parentPackage/firstPackageWithContent
  service interface FirstServiceInterface
package /parentPackage/secondPackageWithContent
  service interface SecondServiceInterface
