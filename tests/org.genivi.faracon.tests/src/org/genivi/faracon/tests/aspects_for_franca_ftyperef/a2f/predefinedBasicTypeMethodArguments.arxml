AUTOSAR XML (schema 4.0)
package /a1/b2/c3
  service interface ExampleInterface
    namespaces:
      symbol props a1
      symbol props b2
      symbol props c3
    methods:
      operation methodWithBasicTypeArguments
        arg uint32_argument: type=UInt32, direction=IN
        arg boolean_argument: type=Boolean, direction=IN
