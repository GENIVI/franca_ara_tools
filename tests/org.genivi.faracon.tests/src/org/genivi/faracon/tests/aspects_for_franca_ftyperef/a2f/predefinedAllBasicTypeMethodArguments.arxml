AUTOSAR XML (schema 4.0)
package /a1/b2/c3
  service interface ExampleInterface
    namespaces:
      symbol props a1
      symbol props b2
      symbol props c3
    methods:
      operation methodWithBasicTypeArguments
        14 x arg, all with direction=IN:
          int8_field: type=Int8
          int16_field: type=Int16
          int32_field: type=Int32
          int64_field: type=Int64
          integer_field: type=Int64
          byteBuffer_field: type=ByteBuffer
          double_field: type=Double
          float_field: type=Float
          string_field: type=String
          uint8_field: type=UInt8
          uint16_field: type=UInt16
          uint32_field: type=UInt32
          uint64_field: type=UInt64
          boolean_field: type=Boolean
