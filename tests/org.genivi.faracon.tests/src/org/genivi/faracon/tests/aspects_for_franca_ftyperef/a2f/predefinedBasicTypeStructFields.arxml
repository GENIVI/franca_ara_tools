AUTOSAR XML (schema 4.0)
package /a1/b2/c3
  service interface ExampleInterface
    namespaces:
      symbol props a1
      symbol props b2
      symbol props c3
package /a1/b2/c3/ExampleInterface
  impl type StructWithBasicTypeFields: category=STRUCTURE
    element uint32_field: implementation-data-type=UInt32
    element boolean_field: implementation-data-type=Boolean
