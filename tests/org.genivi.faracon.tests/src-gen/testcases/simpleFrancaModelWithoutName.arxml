AUTOSAR XML (schema 4.0)
package /a
  service interface ExampleInterface
    namespaces:
      symbol props a
